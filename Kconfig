## Kconfig
```kconfig
# Copyright 2024 NXP
# SPDX-License-Identifier: BSD-3-Clause

menuconfig MCUX_COMPONENT_middleware.wireless.xcvr
    bool "XCVR tranceiver drivers for wireless Products"
    help
      Enable the XCVR drivers

if MCUX_COMPONENT_middleware.wireless.xcvr

  choice
      prompt "XCVR platform selection"

    config MCUX_COMPONENT_middleware.wireless.xcvr.kw45_k32w1_mcxw71
        bool "KW45x, K32W1x, MCXW71x families"
        depends on  MCUX_HW_DEVICE_MCXW716C || MCUX_HW_DEVICE_MCXW716A ||       \
                    MCUX_HW_DEVICE_KW45B41Z52 || MCUX_HW_DEVICE_KW45B41Z53 ||   \
                    MCUX_HW_DEVICE_KW45B41Z82 || MCUX_HW_DEVICE_KW45B41Z83  ||  \
                    MCUX_HW_DEVICE_K32W1480 || MCUX_HW_DEVICE_KW45B41Z83_NBU

    config MCUX_COMPONENT_middleware.wireless.xcvr.kw47_mcxw72
        bool "KW47x, MCXW72x families"
        depends on MCUX_HW_DEVICE_KW47B42ZB7 || MCUX_HW_DEVICE_MCXW727C
        depends on MCUX_HW_DEVICE_KW47B42ZB7_CORE_ID_cm33_core1 || MCUX_HW_DEVICE_MCXW727C_CORE_ID_cm33_core1

    config MCUX_COMPONENT_middleware.wireless.xcvr.gen475
        bool "Gen4.75 support"
        # TODO : Add devices supporting this xcvr port

  endchoice

endif
```
